## drivers/block/oplus_hybridswap/Kconfig
```kconfig
# SPDX-License-Identifier: GPL-2.0-only
menuconfig EVONIX_OPLUS_HYBRIDSWAP
	bool "Oplus HybridSwap storage-backed RAM expansion for Rodin"
	depends on ARM64 && MEMCG && ANDROID_VENDOR_HOOKS
	depends on ZRAM = n && ZSMALLOC = n
	default n
	help
	  Build the Oplus compressed RAM driver, allocator and storage-backed
	  HybridSwap backend. This replaces the existing ZRAM implementation;
	  both providers must never be loaded together. The MediaTek display
	  notifier module must be available before loading HybridSwap.

if EVONIX_OPLUS_HYBRIDSWAP

config EVONIX_OPLUS_HYBRIDSWAP_BUILTIN
	bool "Build the native RAM expansion backend into EVONIX"
	depends on HYBRIDSWAP_ZRAM = y && HYBRID_ZSMALLOC = y
	default n
	help
	  Include the real allocator, ZRAM storage backend and MediaTek display
	  notifier in the kernel image. Requests for redundant ROM modules are
	  recognized only after their built-in providers initialize successfully.
	  This mode does not require modifying vendor_boot or DLKM images.

source "drivers/block/oplus_hybridswap/hybridswap_zram/Kconfig"

config HYBRID_ZSMALLOC_CHAIN_SIZE
	int "HybridSwap allocator maximum pages per zspage"
	depends on HYBRID_ZSMALLOC
	default 8
	range 4 16

config HYBRID_ZSMALLOC_STAT
	bool "Export HybridSwap allocator statistics"
	depends on HYBRID_ZSMALLOC
	select DEBUG_FS
	default n

config HYBRIDSWAP_ZRAM_DEF_COMP
	string
	depends on HYBRIDSWAP_ZRAM
	default "lz4"

endif
```

## drivers/misc/evonix_cos/Kconfig
```kconfig
# SPDX-License-Identifier: GPL-2.0-only
config EVONIX_OPLUS_FRAME_RATE
	tristate "Rodin FrameBoost frame-rate adapter"
	depends on ARM64 && OPLUS_FEATURE_FRAME_BOOST
	default n
	help
	  Connect the Oplus performance HAL frame-rate request to the native
	  FrameBoost SurfaceFlinger interval. This updates scheduling metadata,
	  not the panel mode or CPU/GPU frequency limits.

config EVONIX_OPLUS_TASK_ENERGY
	bool "Rodin runtime-backed Oplus task energy estimates"
	depends on ARM64 && CPU_FREQ_TIMES && ENERGY_MODEL
	default n
	help
	  Provide the Oplus task_cpustats five-second process energy estimate
	  format from real CPU accounting events and the CPU Energy Model.
	  Collection allocates memory and attaches a hook only when enabled.
```

## drivers/power/supply/evonix_rodin_adapter/Kconfig
```kconfig
# SPDX-License-Identifier: GPL-2.0-only
config EVONIX_RODIN_ADAPTER_CLASS
	bool "Rodin native MediaTek adapter class"
	depends on ARM64 && KALLSYMS
	help
	  Provide the real MediaTek adapter class and publish Rodin's PD
	  adapter before installing the charger's response notifier.
```

## drivers/soc/oplus/Kconfig
```kconfig
# SPDX-License-Identifier: GPL-2.0-only

menu "OPlus drivers"

config OPLUS_FEATURE_SCHED_ASSIST
        bool "OPlus SchedAssist"
        default n
        help
          Enable native OPlus SchedAssist imported from the
          MT6899 Linux 6.6 OPlus kernel source.



config EVONIX_OPLUS_SA_COMMON_HOOKS
        bool "EVONIX common scheduler hook bridge"
        depends on OPLUS_FEATURE_SCHED_ASSIST
        default n
        help
          Register enqueue/dequeue vendor hooks directly from the
          common kernel when MediaTek scheduler.ko glue is not used.

config LOCKING_PROTECT
        bool "OPlus SchedAssist locking protection"
        depends on OPLUS_FEATURE_SCHED_ASSIST
        default n
        help
          Enable locking protection required by native
          MT6899 OPlus SchedAssist.


config OPLUS_FEATURE_OPROJECT
        bool "OPlus project/OCDT information"
        default n
        help
          Build the native OPlus MTK project information driver.
          On non-OPlus device trees EVONIX may provide a hardware-ID
          compatibility fallback.


config OPLUS_FEATURE_PHOENIX
        bool "OPlus Phoenix boot monitor"
        default n
        help
          Build the native OPlus Phoenix boot profiling and
          boot-stage monitoring framework.

config EVONIX_OPLUS_PHOENIX_WATCHDOG
        bool "Enable OPlus Phoenix HLOS watchdog"
        depends on OPLUS_FEATURE_PHOENIX
        default n
        help
          Enable active Phoenix boot watchdog recovery.
          Keep disabled until rodin boot-mode detection is validated.

config EVONIX_OPLUS_PHOENIX_RECOVERY
        bool "Enable OPlus Phoenix panic recovery"
        depends on OPLUS_FEATURE_PHOENIX
        default n
        help
          Allow Phoenix hang handling to trigger active recovery.
          Keep disabled during compatibility testing.

endmenu
source "drivers/soc/oplus/device_info/Kconfig"
source "drivers/soc/oplus/midas/Kconfig"
source "drivers/soc/oplus/cpufreq_health/Kconfig"
source "drivers/soc/oplus/frame_boost/Kconfig"

source "drivers/soc/oplus/healthinfo_lite/Kconfig"
```

## drivers/soc/oplus/cpufreq_health/Kconfig
```kconfig
config OPLUS_FEATURE_OCH
	bool "OPlus cpufreq health"
	depends on CPU_FREQ
	default n
	help
	  Enable native OPlus CPU frequency floor/ceiling health statistics
	  and expose them to MIDAS v2.
```

## drivers/soc/oplus/device_info/Kconfig
```kconfig
config OPLUS_DEVICE_IFNO
        bool "OPlus device information"
        default n
        help
          Build the native OPlus device_info framework.

config OPLUS_DEVICE_INFO_MTK_PLATFORM
        bool "OPlus device info MTK platform"
        depends on OPLUS_DEVICE_IFNO
        default n
        help
          Use the MediaTek device_info platform implementation.
```

## drivers/soc/oplus/frame_boost/Kconfig
```kconfig
config OPLUS_FEATURE_FRAME_BOOST
        bool "OPlus Frame Boost Core"
        depends on OPLUS_FEATURE_SCHED_ASSIST
        default n
        help
          Enable native OPlus Frame Boost core.
          CFBT and GEAS are intentionally disabled.

config EVONIX_OPLUS_FRAME_IOCTL
        bool "Oplus native FrameBoost control protocol"
        depends on OPLUS_FEATURE_FRAME_BOOST
        default n
        help
          Route Oplus frame-control ioctls to the native FrameBoost core.
          Requires userspace ABI and on-device validation before production.
```

## drivers/soc/oplus/game_opt/Kconfig
```kconfig
# SPDX-License-Identifier: GPL-2.0-only

config OPLUS_FEATURE_GAME_OPT
	bool "OPlus GameOpt"
	default n
	help
	  Enable the native OPlus MT6899 GameOpt framework.
	  Provides /proc/game_opt interfaces used by ColorOS GameOpt HAL,
	  including CPU load, render-thread tracking, frequency controls,
	  early detection, frame synchronization and task boosting.
```

## drivers/soc/oplus/healthinfo_lite/Kconfig
```kconfig
config EVONIX_OPLUS_HEALTHINFO_LITE
	bool "EVONIX OPlus HealthInfo Lite"
	default n
	help
	  Minimal OPlus HealthInfo compatibility interface.

	  Provides:
	    /proc/oplus_healthinfo/cpu_loading

	  Intended for ColorOS PerformanceService compatibility without
	  importing the complete OPlus sched_info subsystem.
```

## drivers/soc/oplus/midas/Kconfig
```kconfig
config OPLUS_FEATURE_MIDAS_V2
	bool "OPlus MIDAS v2"
	depends on DUMP_TASKS_MEM
	default n
	help
	  Enable the native OPlus MIDAS v2 framework.
```

## drivers/soc/oplus/sched_info/Kconfig
```kconfig
# SPDX-License-Identifier: GPL-2.0-only
config OPLUS_FEATURE_CPU_JANKINFO
	bool "Oplus native scheduler information"
	depends on ARM64 && SMP && CPUSETS && CPU_FREQ && OPLUS_FEATURE_SCHED_ASSIST
	depends on !EVONIX_OPLUS_HEALTHINFO_LITE
	default n
	help
	  Collect real task, CPU-load and frequency history for the Oplus
	  scheduler-information interfaces. Requires Rodin topology and
	  lifecycle validation before production enablement.

config JANK_DEBUG
	bool "Oplus scheduler information debug tracing"
	depends on OPLUS_FEATURE_CPU_JANKINFO
	default n
```

## drivers/soc/oplus/waker_identify/Kconfig
```kconfig
config OPLUS_FEATURE_WAKER_IDENTIFY
	bool "OPlus Waker Identify"
	default n
	help
	  Native OPlus wake relationship tracking.

	  Provides:
	    /proc/waker_identify/waker_info
	    /proc/waker_identify/rt_info
	    /proc/waker_identify/enable
	    /proc/waker_identify/debug_enable
```

## mm/oplus_mm/Kconfig
```kconfig
config DUMP_TASKS_MEM
        bool "OPlus dump userspace process memory"
        default n
        help
          Dump userspace process memory information through
          the native OPlus memory monitor interface.

config OPLUS_FEATURE_SIGKILL_DIAGNOSIS
        bool "OPlus SIGKILL diagnosis"
        default n
        help
          Record SIGKILL reason information for OPlus userspace
          diagnostics.
```
